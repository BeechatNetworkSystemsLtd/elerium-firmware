## boards/beechat/elerium_u5/elerium_u5_defconfig
```kconfig
CONFIG_ARM_MPU=y
CONFIG_HW_STACK_PROTECTION=y
CONFIG_GPIO=y
CONFIG_CLOCK_CONTROL=y
CONFIG_PINCTRL=y
```

## drivers/ntag5/Kconfig.ntag5
```kconfig
# NXP NTAG5 driver options

menuconfig NTAG5
	bool "NTAG5 driver support"
	default y
	depends on DT_HAS_NXP_NTAG5_ENABLED
	select I2C

if NTAG5

endif
```

## dts/bindings/nxp,ntag5.yaml
```yaml
description: NXP nTAG V

compatible: "nxp,ntag5"

include: i2c-device.yaml

properties:
  ed-gpios:
    type: phandle-array
    description: |
      ED Pin
```

## lib/Kconfig
```kconfig
config BEECHAT_ELERIUM_LIB
    bool "Beechat Elerium Library"
    default n
    select EVENTS
    select CRC
    select NVS
    select FLASH
    help
        Beechat Elerium Library

if BEECHAT_ELERIUM_LIB

    config BEECHAT_ELERIUM_WALLET
        bool "Elerium Wallet"
        default n


    config BEECHAT_ELERIUM_URL_SIGN
        bool "Elerium URL Signer"
        default n

    module = ELERIUM
    module-str = elerium
    source "subsys/logging/Kconfig.template.log_config"

endif
```

## west.yml
```yaml
manifest:
  self:
    path: elerium

  remotes:
    - name: zephyrproject-rtos
      url-base: https://github.com/zephyrproject-rtos
    - name: ElementsProject
      url-base: https://github.com/ElementsProject

  projects:
    - name: zephyr
      remote: zephyrproject-rtos
      revision: main
      import:
        name-allowlist:
          - cmsis
          - hal_stm32
          - tinycrypt
          - tinicbor
    - name: mcuboot
      remote: zephyrproject-rtos
      revision: fb2cf0ec3da3687b93f28e556ab682bdd4b85223
      path: mcuboot
    - name: libwally-core
      remote: ElementsProject
      revision: release_1.3.1
      path: libwally-core
```
